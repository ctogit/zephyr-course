## prj.conf
```kconfig
# Enable the Ztest unit testing framework
CONFIG_ZTEST=y

# Randomize suite and test order to catch ordering dependencies early
#CONFIG_ZTEST_SHUFFLE=y

# Enable logging
CONFIG_LOG=y
```

## src/test_ring_buf.c
```c
/*
 * Ring Buffer Module - Homework Test Skeleton
 *
 * test_fresh_state is provided as a worked example. Fill in the remaining
 * 7 ZTEST bodies according to TEST_SPEC.md. Stubs call ztest_test_skip()
 * so the binary builds and runs cleanly before each test is implemented.
 *
 * Run:
 *   west twister -T tests/ring_buf -p native_sim
 */

#include <zephyr/ztest.h>
#include <errno.h>

#include "ring_buf.h"

/*
 * Shared before hook: every suite reinitialises the ring buffer with a
 * capacity of 4 so tests start from a clean, known state. Capacity 4 is
 * enough to exercise FIFO order (push 1, 2, 3) and overflow (full at 4).
 */
static void before(void *f)
{
	ARG_UNUSED(f);
	rb_init(4);
}

/*
 * ============================================================================
 * Test Suite: ring_buf_init
 *
 * Initial state and re-initialization behaviour.
 * ============================================================================
 */
ZTEST_SUITE(ring_buf_init, NULL, NULL, before, NULL, NULL);

/* PROVIDED — study this test before writing the rest. */
ZTEST(ring_buf_init, test_fresh_state)
{
	zassert_true(rb_is_empty(), "Fresh buffer must be empty");
	zassert_equal(rb_count(), 0, "Fresh buffer count must be 0");
}

ZTEST(ring_buf_init, test_reinit_clears_state)
{
	/* TODO(l8-task1): Push a value, call rb_init(4) again, then
	 * verify the buffer is empty and count is 0.
	 * See TEST_SPEC.md "Suite ring_buf_init" #2.
	 */

	zassert_equal(rb_push(99), 0, "Push should succeed");
	zassert_equal(rb_init(4), 0, "Re-init the ring buffer should return 0");
	zassert_true(rb_is_empty(), "Fresh buffer must be empty");
	zassert_equal(rb_count(), 0, "Fresh buffer count must be 0");
}

/*
 * ============================================================================
 * Test Suite: ring_buf_push_pop
 *
 * Single push/pop round-trip, FIFO order, full error path.
 * ============================================================================
 */
ZTEST_SUITE(ring_buf_push_pop, NULL, NULL, before, NULL, NULL);

ZTEST(ring_buf_push_pop, test_single_push_pop)
{
	/* TODO(l8-task1): rb_push(42), rb_pop(&v) -> v == 42, buffer empty after.
	 * See TEST_SPEC.md "Suite ring_buf_push_pop" #1.
	 */
	int v;
	zassert_ok(rb_push(42), "Push should succeed and return 0");
	zassert_ok(rb_pop(&v), "Pop should succeed and 42 loaded in v");
	zassert_equal(v, 42, "Pop value should be 42 because it was the oldest value pushed");
	zassert_true(rb_is_empty(), "Buffer must be empty after Pop");
}

ZTEST(ring_buf_push_pop, test_fifo_order)
{
	/* TODO(l8-task1): rb_push(1), rb_push(2), rb_push(3); pop three times
	 * and verify the values come out as 1, 2, 3 in that order.
	 * See TEST_SPEC.md "Suite ring_buf_push_pop" #2.
	 */
	int v, w, z;

	zassert_ok(rb_push(1), "Push should succeed and return 0");
	zassert_ok(rb_push(2), "Push should succeed and return 0");
	zassert_ok(rb_push(3), "Push should succeed and return 0");
	
	zassert_ok(rb_pop(&v), "Pop should succeed and 1 loaded in v");
	zassert_ok(rb_pop(&w), "Pop should succeed and 2 loaded in w");
	zassert_ok(rb_pop(&z), "Pop should succeed and 3 loaded in z");

	zassert_equal(v, 1, "Pop value should be 1 because it was the oldest value pushed");
	zassert_equal(w, 2, "Pop value should be 2");
	zassert_equal(z, 3, "Pop value should be 3 because it was the newest value pushed");

	zassert_true(rb_is_empty(), "Buffer must be empty after Pop");
}

ZTEST(ring_buf_push_pop, test_push_full_returns_enospc)
{
	/* TODO(l8-task1): Fill the buffer to its capacity of 4, then push
	 * one more value -> -ENOSPC.
	 * See TEST_SPEC.md "Suite ring_buf_push_pop" #3.
	 */

	zassert_ok(rb_push(1), "Push should succeed and return 0");
	zassert_ok(rb_push(2), "Push should succeed and return 0");
	zassert_ok(rb_push(3), "Push should succeed and return 0");
	zassert_ok(rb_push(4), "Push should succeed and return 0");

	zassert_true(rb_is_full(), "Should be true");

	zassert_equal(rb_push(99), -ENOSPC, "Should return that msg: Error No Space");

	zassert_equal(rb_count(), 4, "5th element out");
}

/*
 * ============================================================================
 * Test Suite: ring_buf_boundaries
 *
 * Peek semantics and NULL-pointer boundary conditions.
 * ============================================================================
 */
ZTEST_SUITE(ring_buf_boundaries, NULL, NULL, before, NULL, NULL);

ZTEST(ring_buf_boundaries, test_peek_does_not_consume)
{
	/* TODO(l8-task1): rb_push(7); rb_peek(&v) -> v == 7; rb_peek(&v) again
	 * -> v == 7; rb_count() still == 1.
	 * See TEST_SPEC.md "Suite ring_buf_boundaries" #1.
	 */
	int v;
	zassert_ok(rb_push(7), "Push should succeed and return 0");

	zassert_ok(rb_peek(&v), "Pick should succeed and value 7 loaded in v");
	zassert_equal(v, 7, "Value peeked first time");
	zassert_ok(rb_peek(&v), "Pick should succeed and value 7 loaded in v");
	zassert_equal(v, 7, "Value peeked second time");

	zassert_equal(rb_count(), 1, "I peeked 2 times, but count should remains 1");
}

ZTEST(ring_buf_boundaries, test_pop_null_returns_einval)
{
	/* TODO(l8-task1): rb_pop(NULL) -> -EINVAL.
	 * See TEST_SPEC.md "Suite ring_buf_boundaries" #2.
	 */
	zassert_equal(rb_pop(NULL), -EINVAL, "Pop should return msg Error Input Value");
}

ZTEST(ring_buf_boundaries, test_is_full_after_fill)
{
	/* TODO(l8-task1): push 4 values -> rb_is_full() == true, rb_count() == 4.
	 * See TEST_SPEC.md "Suite ring_buf_boundaries" #3.
	 */
	zassert_ok(rb_push(1), "Push should succeed and return 0");
	zassert_ok(rb_push(2), "Push should succeed and return 0");
	zassert_ok(rb_push(3), "Push should succeed and return 0");
	zassert_ok(rb_push(4), "Push should succeed and return 0");

	zassert_true(rb_is_full(), "Buffer should be full");

	zassert_equal(rb_count(), 4, "4 values were loaded");
}
```
