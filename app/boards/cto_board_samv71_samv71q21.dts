/*
 * Copyright (c) 2017 Piotr Mienkowski
 * Copyright (c) 2017 Justin Watson
 * Copyright (c) 2020-2024 Gerson Fernando Budke <nandojve@gmail.com>
 *
 * SPDX-License-Identifier: Apache-2.0
 */

/dts-v1/;

#include <atmel/samv71x21.dtsi>
#include "cto_board_samv71-common.dtsi"

/ {
	model = "Atmel SAM V71 Xplained Ultra board";
	compatible = "nasa,cto_board_samv71", "atmel,sam_v71_xult", "atmel,samv71q21", "atmel,samv71";
};
