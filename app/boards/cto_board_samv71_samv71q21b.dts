/*
 * Copyright (c) 2020 Stephanos Ioannidis <root@stephanos.io>
 * Copyright (c) 2020-2024 Gerson Fernando Budke <nandojve@gmail.com>
 *
 * SPDX-License-Identifier: Apache-2.0
 */

/dts-v1/;

#include <atmel/samv71x21b.dtsi>
#include "cto_board_samv71-common.dtsi"

/ {
	model = "Atmel SAM V71B Xplained Ultra board";
	compatible = "nasa,cto_board_samv71", "atmel,sam_v71_xult", "atmel,samv71q21b", "atmel,samv71b";
};
