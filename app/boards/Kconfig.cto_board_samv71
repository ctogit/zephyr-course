## app/boards/Kconfig.cto_board_samv71
```kconfig
# Copyright (c) 2016 Piotr Mienkowski
# Copyright (c) 2024 Gerson Fernando Budke <nandojve@gmail.com>
# SPDX-License-Identifier: Apache-2.0

config BOARD_CTO_BOARD_SAMV71
	select SOC_SAMV71Q21 if BOARD_CTO_BOARD_SAMV71_SAMV71Q21
	select SOC_SAMV71Q21B if BOARD_CTO_BOARD_SAMV71_SAMV71Q21B
```

## app/boards/board.yml
```yaml
board:
  name: cto_board_samv71
  full_name: SAM V71(B) Xplained Ultra edited by CTo
  vendor: cto
  socs:
    - name: samv71q21
    - name: samv71q21b
```

## app/boards/my_cto_board/board.yml
```yaml
board:
  name: my_cto_board
  full_name: SAM V71(B) Xplained Ultra edited by CTo
  vendor: na-sa
  socs:
    - name: samv71q21
    - name: samv71q21b
```

## app/drivers/subsys/our_driver/Kconfig
```kconfig
menuconfig OUR_SENSOR
    bool "Enable our sensor"
    default y
    select GPIO
    depends on DT_HAS_OUR_SENSOR_ENABLED
    help
        Our super dupper driver

if OUR_SENSOR
config OUR_SENSOR_INIT_STATE
    bool "Start as low"
    default n
endif
```

## twister-out.2/native_sim_native/host_gnu/zephyr-course/tests/ring_buf/homework.unit.ring_buf/Kconfig/arch/Kconfig.tmp
```kconfig
# Load Zephyr Arch Kconfig descriptions.
osource "/home/cto/zephyrproject/zephyr/arch/rx/Kconfig"
osource "/home/cto/zephyrproject/zephyr/arch/x86/Kconfig"
osource "/home/cto/zephyrproject/zephyr/arch/xtensa/Kconfig"
osource "/home/cto/zephyrproject/zephyr/arch/sparc/Kconfig"
osource "/home/cto/zephyrproject/zephyr/arch/riscv/Kconfig"
osource "/home/cto/zephyrproject/zephyr/arch/posix/Kconfig"
osource "/home/cto/zephyrproject/zephyr/arch/openrisc/Kconfig"
osource "/home/cto/zephyrproject/zephyr/arch/mips/Kconfig"
osource "/home/cto/zephyrproject/zephyr/arch/arm64/Kconfig"
osource "/home/cto/zephyrproject/zephyr/arch/arm/Kconfig"
osource "/home/cto/zephyrproject/zephyr/arch/arc/Kconfig"
```

## twister-out.3/native_sim_native/host_gnu/zephyr-course/tests/ring_buf/homework.unit.ring_buf/Kconfig/boards/Kconfig.defconfig.tmp
```kconfig
# Load Zephyr board defconfig descriptions.
osource "/home/cto/zephyrproject/zephyr/boards/native/native_sim/Kconfig.defconfig"
```

## twister-out.4/native_sim_native/host_gnu/zephyr-course/tests/ring_buf/homework.unit.ring_buf/Kconfig/boards/Kconfig
```kconfig
# Load Zephyr board Kconfig descriptions.
osource "/home/cto/zephyrproject/zephyr/boards/native/native_sim/Kconfig"
```

## twister-out.4/native_sim_native/host_gnu/zephyr-course/tests/ring_buf/homework.unit.ring_buf/Kconfig/boards/Kconfig.sysbuild
```kconfig
# Load Sysbuild board Kconfig descriptions.
osource "/home/cto/zephyrproject/zephyr/boards/native/native_sim/Kconfig.sysbuild"
```
